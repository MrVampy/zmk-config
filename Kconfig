## Kconfig
```kconfig
menu "Corne custom firmware"

config ZMK_CORNE_HOTPATHS
    bool "Corne typing hot-path overrides"
    default y if BOARD_CORNE_CHOC_PRO_LEFT
    depends on BOARD_CORNE_CHOC_PRO_LEFT && ZMK_SPLIT_ROLE_CENTRAL

if ZMK_CORNE_HOTPATHS

config ZMK_CORNE_HOTPATH_SI_TIMEOUT_MS
    int "S then I uppercase hot-path timeout"
    default 100
    range 1 500

config ZMK_CORNE_HOTPATH_COMBO_TIMEOUT_MS
    int "Guarded combo press window"
    default 50
    range 1 500

config ZMK_CORNE_HOTPATH_COMBO_IDLE_MS
    int "Guarded combo physical prior idle"
    default 220
    range 0 1000

endif # ZMK_CORNE_HOTPATHS

endmenu
```

## dts/bindings/behaviors/zmk,behavior-reactive-rgb.yaml
```yaml
# Copyright (c) 2026 MrVampy
# SPDX-License-Identifier: MIT

description: Reactive RGB Action

compatible: "zmk,behavior-reactive-rgb"

include: two_param.yaml
```
