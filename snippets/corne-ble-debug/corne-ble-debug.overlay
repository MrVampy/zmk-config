/ {
    chosen {
        zephyr,console = &snippet_corne_ble_debug_uart;
        zephyr,shell-uart = &snippet_corne_ble_debug_uart;
    };
};

&zephyr_udc0 {
    snippet_corne_ble_debug_uart: snippet_corne_ble_debug_uart {
        compatible = "zephyr,cdc-acm-uart";
    };
};
